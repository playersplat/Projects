/* Generated by Yosys 0.25 (git sha1 e02b7f64bc7, clang 14.0.0 -fPIC -Os) */

(* hdlname = "\\graycounter" *)
(* dynports =  1  *)
(* top =  1  *)
(* src = "graycounter.soln.sv:1.1-37.10" *)
module graycounter(clk_i, reset_i, up_i, gray_o);
  wire _00_;
  wire _01_;
  wire _02_;
  wire _03_;
  wire _04_;
  wire _05_;
  wire _06_;
  wire _07_;
  (* src = "graycounter.soln.sv:12.24-12.32" *)
  (* unused_bits = "0 1 2" *)
  wire [3:0] binary_l;
  (* src = "graycounter.soln.sv:3.17-3.22" *)
  input clk_i;
  wire clk_i;
  (* src = "graycounter.soln.sv:14.24-14.33" *)
  wire [3:0] counter_n;
  (* src = "graycounter.soln.sv:6.26-6.32" *)
  output [3:0] gray_o;
  wire [3:0] gray_o;
  (* src = "graycounter.soln.sv:8.24-8.30" *)
  reg [3:0] gray_r;
  (* src = "graycounter.soln.sv:4.17-4.24" *)
  input reset_i;
  wire reset_i;
  (* src = "graycounter.soln.sv:13.24-13.30" *)
  (* unused_bits = "0 1 2" *)
  wire [3:0] temp_n;
  (* src = "graycounter.soln.sv:5.17-5.21" *)
  input up_i;
  wire up_i;
  assign _07_ = gray_r[0] ^ gray_r[1];
  assign _00_ = ~(gray_r[3] ^ gray_r[2]);
  assign _01_ = ~(_00_ ^ _07_);
  assign _02_ = ~(gray_r[2] ^ gray_r[1]);
  assign _03_ = _02_ ^ gray_r[3];
  assign _04_ = _03_ ^ _01_;
  assign counter_n[0] = _04_ ^ _01_;
  assign counter_n[1] = _03_ ? _07_ : _00_;
  assign _05_ = _03_ | ~(_01_);
  assign temp_n[3] = _05_ ? gray_r[3] : gray_r[2];
  assign _06_ = ~gray_r[3];
  assign counter_n[2] = _05_ ? gray_r[2] : _06_;
  (* \always_ff  = 32'd1 *)
  (* src = "graycounter.soln.sv:29.4-35.7" *)
  always @(posedge clk_i)
    if (reset_i) gray_r[0] <= 1'h0;
    else if (up_i) gray_r[0] <= counter_n[0];
  (* \always_ff  = 32'd1 *)
  (* src = "graycounter.soln.sv:29.4-35.7" *)
  always @(posedge clk_i)
    if (reset_i) gray_r[1] <= 1'h0;
    else if (up_i) gray_r[1] <= counter_n[1];
  (* \always_ff  = 32'd1 *)
  (* src = "graycounter.soln.sv:29.4-35.7" *)
  always @(posedge clk_i)
    if (reset_i) gray_r[2] <= 1'h0;
    else if (up_i) gray_r[2] <= counter_n[2];
  (* \always_ff  = 32'd1 *)
  (* src = "graycounter.soln.sv:29.4-35.7" *)
  always @(posedge clk_i)
    if (reset_i) gray_r[3] <= 1'h0;
    else if (up_i) gray_r[3] <= temp_n[3];
  assign binary_l[3] = gray_r[3];
  assign counter_n[3] = temp_n[3];
  assign gray_o = gray_r;
endmodule

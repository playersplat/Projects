/* Generated by Yosys 0.25 (git sha1 e02b7f64bc7, clang 14.0.0 -fPIC -Os) */

(* hdlname = "\\graycounter" *)
(* dynports =  1  *)
(* top =  1  *)
(* src = "graycounter.soln2.sv:1.1-27.10" *)
module graycounter(clk_i, reset_i, up_i, gray_o);
  wire _00_;
  wire _01_;
  wire _02_;
  wire _03_;
  (* src = "graycounter.soln2.sv:3.17-3.22" *)
  input clk_i;
  wire clk_i;
  wire [3:0] counter_n;
  (* src = "graycounter.soln2.sv:8.28-8.37" *)
  reg [3:0] counter_r;
  (* src = "graycounter.soln2.sv:6.26-6.32" *)
  output [3:0] gray_o;
  wire [3:0] gray_o;
  wire incrval_w;
  (* src = "graycounter.soln2.sv:4.17-4.24" *)
  input reset_i;
  wire reset_i;
  (* src = "graycounter.soln2.sv:5.17-5.21" *)
  input up_i;
  wire up_i;
  assign _00_ = ~counter_r[1];
  assign _01_ = ~(up_i & counter_r[0]);
  assign counter_n[1] = _01_ ^ _00_;
  assign _02_ = _01_ | _00_;
  assign counter_n[2] = ~(_02_ ^ counter_r[2]);
  assign _03_ = counter_r[2] & ~(_02_);
  assign counter_n[3] = _03_ ^ counter_r[3];
  assign counter_n[0] = up_i ^ counter_r[0];
  assign gray_o[0] = counter_r[0] ^ counter_r[2];
  assign gray_o[1] = counter_r[3] ^ counter_r[1];
  (* \always_ff  = 32'd1 *)
  (* src = "graycounter.soln2.sv:12.4-18.7" *)
  always @(posedge clk_i)
    if (reset_i) counter_r[0] <= 1'h0;
    else counter_r[0] <= counter_n[0];
  (* \always_ff  = 32'd1 *)
  (* src = "graycounter.soln2.sv:12.4-18.7" *)
  always @(posedge clk_i)
    if (reset_i) counter_r[1] <= 1'h0;
    else counter_r[1] <= counter_n[1];
  (* \always_ff  = 32'd1 *)
  (* src = "graycounter.soln2.sv:12.4-18.7" *)
  always @(posedge clk_i)
    if (reset_i) counter_r[2] <= 1'h0;
    else counter_r[2] <= counter_n[2];
  (* \always_ff  = 32'd1 *)
  (* src = "graycounter.soln2.sv:12.4-18.7" *)
  always @(posedge clk_i)
    if (reset_i) counter_r[3] <= 1'h0;
    else counter_r[3] <= counter_n[3];
  assign gray_o[3:2] = counter_r[3:2];
  assign incrval_w = up_i;
endmodule
